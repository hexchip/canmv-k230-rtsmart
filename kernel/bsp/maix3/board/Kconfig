## kernel/bsp/maix3/board/Kconfig
```kconfig
menu "Board Configuration"

    config RT_USING_MPP
        bool "Use Kendryte MPP"
        default y

    config RT_FASTBOOT
        bool "Fastboot, disable some log output"
        default n

    config RT_BOARD_ENABLE_PINMUX
        bool "Enable Pinmux Configure"
        default n

endmenu
```

## kernel/bsp/maix3/components/display_manager/Kconfig
```kconfig
menuconfig USING_DISPLAY_MANAGER
    bool "DisplayManager"
    default n

    if USING_DISPLAY_MANAGER

    endif
```

## kernel/bsp/maix3/components/lvgl/Kconfig
```kconfig
menuconfig PKG_USING_LVGL
    bool "LVGL (official): Light and Versatile Graphics Library"
    default n
    select USING_DISPLAY_MANAGER

    if PKG_USING_LVGL
        config PKG_LVGL_THREAD_STACK_SIZE
        int "Thread stack size"
        default 8192

        config PKG_LVGL_THREAD_PRIO
        int "Thread priority"
        default 21

        config PKG_LVGL_USING_EXAMPLES
        bool "Using Examples"
        default n

        config PKG_LVGL_USING_DEMOS
        bool "Using demos"
        default n
    endif
```

## kernel/bsp/maix3/components/rotary_knob/Kconfig
```kconfig
menuconfig ENABLE_ROTARY_KNOB
    bool "Enable Rotary Knob"
    default y
    select ENABLE_ROTARY_ENCODER

    if ENABLE_ROTARY_KNOB

    endif
    
```

## kernel/bsp/maix3/components/terminal/Kconfig
```kconfig
menuconfig ENABLE_TERMINAL
    bool "Enable Terminal"
    default y
    select RT_USING_HEAP
    select RT_USING_DEVICE_WRAP
    select PKG_USING_LVGL

    if ENABLE_TERMINAL
        config TERMINAL_MQ_MSG_MAX_NUM
        int "Maximum number of mq's messages"
        default 64

        config TERMINAL_MQ_MSG_SHORT_STR_LEN
        int "Maximum length of short_str in mq's messages"
        default 32

        choice TERMINAL_FONT
            prompt "Choice Terminal font"
            default TERMINAL_FONT_UNSCII_16

            config TERMINAL_FONT_UNSCII_8
                bool "UNSCII_8"

            config TERMINAL_FONT_UNSCII_16
                bool "UNSCII_16"
        endchoice
    endif
```

## kernel/bsp/maix3/drivers/Kconfig
```kconfig
menu "Drivers Configuration"

    source "drivers/interdrv/Kconfig"
    source "drivers/extdrv/Kconfig"

endmenu
```

## kernel/bsp/maix3/drivers/extdrv/Kconfig
```kconfig
menu "Ext Driver"
    menuconfig RT_USING_CYW43XX
        bool "Enable CYW43XX WiFi Driver"
        default n

        if RT_USING_CYW43XX
            choice CYW43XX_SDIO_DEV
                bool "CYW43XX Wifi Use SDIO Device"

                config CYW43XX_SDIO_DEV0
                    bool "Using SDIO0"
                config CYW43XX_SDIO_DEV1
                    bool "Using SDIO1"
            endchoice

            config CYW43XX_SDIO_DEV
                int
                default 0 if CYW43XX_SDIO_DEV0
                default 1 if CYW43XX_SDIO_DEV1

            config CYW43_PIN_WL_REG_ON
                int "CYW43XX REG_ON Pin"
                default 1

            config CYW43XX_THREAD_PRIORITY
                int
                default 10
            config CYW43XX_THREAD_STACK_SIZE
                int
                default 4096
        endif

    menuconfig RT_USING_EEPROM
        bool "Enable EEPROM over GPIO Driver"
        default n

        if RT_USING_EEPROM


        endif

    menuconfig RT_USING_REALTEK
        bool "Enable Realtek WiFi Driver"
        default n

        if RT_USING_REALTEK
            choice REALTEK_SDIO_DEV
                bool "Realtek Wifi Use SDIO Device"

                config REALTEK_SDIO_DEV0
                    bool "Using SDIO0"
                config REALTEK_SDIO_DEV1
                    bool "Using SDIO1"
            endchoice

            config REALTEK_SDIO_DEV
                int
                default 0 if REALTEK_SDIO_DEV0
                default 1 if REALTEK_SDIO_DEV1
        endif

    menuconfig RT_USING_REGULATOR
        bool "Enable regulator Driver"
        depends on RT_USING_PM
        default n

        if RT_USING_REGULATOR
            config RT_USING_REGULATOR_TPS6286X
                bool "Use TPS6286X"
                default n

            menuconfig RT_USING_REGULATOR_CPU
                bool "Enable regulator for CPU"

                if RT_USING_REGULATOR_CPU
                    config RT_REGULATOR_CPU_I2C_DEV
                        string "Regulator for CPU I2C Device name"
                endif

            menuconfig RT_USING_REGULATOR_KPU
                bool "Enable regulator for KPU"

                if RT_USING_REGULATOR_KPU
                    config RT_REGULATOR_KPU_I2C_DEV
                        string "Regulator for KPU I2C Device name"
                endif
        endif

    source "drivers/extdrv/touch/Kconfig"

    menuconfig RT_USING_WS2812
        bool "Enable WS2812"
        default n

        if RT_USING_WS2812
            choice WS2812_USE_DRV
                bool "WS2812 Use Drive mode"
                default WS2812_USE_DRV_GPIO

                config WS2812_USE_DRV_GPIO
                    bool "Using GPIO"
                config WS2812_USE_DRV_I2S
                    bool "Using I2S"
            endchoice

            if WS2812_USE_DRV_GPIO
                config WS2812_GPIO_PIN_NUM
                    int "WS2812 GPIO Output Pin"
                    default 35
            endif
        endif

endmenu
```

## kernel/bsp/maix3/drivers/extdrv/cyw43xx/Kconfig
```kconfig
menuconfig RT_USING_CYW43XX
    bool "Enable CYW43XX WiFi Driver"
    default n

    if RT_USING_CYW43XX
        choice CYW43XX_SDIO_DEV
            bool "CYW43XX Wifi Use SDIO Device"

            config CYW43XX_SDIO_DEV0
                bool "Using SDIO0"
            config CYW43XX_SDIO_DEV1
                bool "Using SDIO1"
        endchoice

        config CYW43XX_SDIO_DEV
            int
            default 0 if CYW43XX_SDIO_DEV0
            default 1 if CYW43XX_SDIO_DEV1

        config CYW43_PIN_WL_REG_ON
            int "CYW43XX REG_ON Pin"
            default 1

        config CYW43XX_THREAD_PRIORITY
            int
            default 10
        config CYW43XX_THREAD_STACK_SIZE
            int
            default 4096
    endif
```

## kernel/bsp/maix3/drivers/extdrv/device_warp/Kconfig
```kconfig
menuconfig RT_USING_DEVICE_WRAP
    bool "Enable Driver wrap"
    default n
    select RT_USING_HEAP

    help 
        device_wrap enables you to listen to and intercept the lifecycle of the device.
```

## kernel/bsp/maix3/drivers/extdrv/eeprom/Kconfig
```kconfig
menuconfig RT_USING_EEPROM
    bool "Enable EEPROM over GPIO Driver"
    default n

    if RT_USING_EEPROM


    endif
```

## kernel/bsp/maix3/drivers/extdrv/regulator/Kconfig
```kconfig
menuconfig RT_USING_REGULATOR
    bool "Enable regulator Driver"
    depends on RT_USING_PM
    default n

    if RT_USING_REGULATOR
        config RT_USING_REGULATOR_TPS6286X
            bool "Use TPS6286X"
            default n

        menuconfig RT_USING_REGULATOR_CPU
            bool "Enable regulator for CPU"

            if RT_USING_REGULATOR_CPU
                config RT_REGULATOR_CPU_I2C_DEV
                    string "Regulator for CPU I2C Device name"
            endif

        menuconfig RT_USING_REGULATOR_KPU
            bool "Enable regulator for KPU"

            if RT_USING_REGULATOR_KPU
                config RT_REGULATOR_KPU_I2C_DEV
                    string "Regulator for KPU I2C Device name"
            endif
    endif
```

## kernel/bsp/maix3/drivers/extdrv/rotary_encoder/Kconfig
```kconfig
menuconfig ENABLE_ROTARY_ENCODER
    bool "Enable rotary encoder"
    default y
    select RT_USING_HEAP
```

## kernel/bsp/maix3/drivers/extdrv/spinand/Kconfig
```kconfig
# Kconfig file for package spinand
menuconfig LPKG_USING_SPINAND
    bool "SPINAND Driver library"
    default n

if LPKG_USING_SPINAND

choice
    bool "SPI Nand On"

    config SPI_NAND_ON_OSPI
        bool "ospi"
    config SPI_NAND_ON_QSPI0
        bool "qspi0"
    config SPI_NAND_ON_QSPI1
        bool "qspi1"
endchoice

config SPI_NAND_SPI_DEV
    string
    default "spi0" if SPI_NAND_ON_OSPI
    default "spi1" if SPI_NAND_ON_QSPI0
    default "spi2" if SPI_NAND_ON_QSPI1

choice
    bool "SPI Nand Bus Width"
    default SPI_NAND_SPI_BUS_WIDTH_4

    config SPI_NAND_SPI_BUS_WIDTH_1
        bool "1"
    config SPI_NAND_SPI_BUS_WIDTH_2
        bool "2"
    config SPI_NAND_SPI_BUS_WIDTH_4
        bool "4"
endchoice

config SPI_NAND_SPI_BUS_WIDTH
    int
    default 1 if SPI_NAND_SPI_BUS_WIDTH_1
    default 2 if SPI_NAND_SPI_BUS_WIDTH_2
    default 4 if SPI_NAND_SPI_BUS_WIDTH_4

config SPI_NAND_SPI_FREQ
    int "SPI Nand Bus Freq"
    default 50000000

config SPI_NAND_DOSILICON
	bool "Support Dosilicon SPI NAND"
    default n
	help
        Enable this driver for Dosilicon SPI NAND flash.

config SPI_NAND_ETRON
	bool "Support Etron SPI NAND"
    default n
	help
        Enable this driver for Etron SPI NAND flash.

config SPI_NAND_MICRON
	bool "Support Micron SPI NAND"
    default n
	help
        Enable this driver for Micron SPI NAND flash.

config SPI_NAND_MACRONIX
    bool "Support Macronix SPI NAND"
    default n
    help
        Enable this driver for Macronix SPI NAND flash.

config SPI_NAND_WINBOND
    bool "Support Winbond SPI NAND"
    default y
    help
        Enable this driver for Winbond SPI NAND flash.

config SPI_NAND_GIGADEVICE
    bool "Support GigaDevice SPI NAND"
    default n
    help
        Enable this driver for GigaDevice SPI NAND flash.

config SPI_NAND_TOSHIBA
    bool "Support Toshiba SPI NAND"
    default n
    help
        Enable this driver for Toshiba/Kioxia SPI NAND flash.

config SPI_NAND_FORESEE
    bool "Support Foresee SPI NAND"
    default n
    help
        Enable this driver for Foresee SPI NAND flash.

config SPI_NAND_XTX
    bool "Support Xtx SPI NAND"
    default n
    help
        Enable this driver for Xtx SPI NAND flash.

config SPI_NAND_ZETTA
    bool "Support Zetta SPI NAND"
    default n
    help
        Enable this driver for Zetta SPI NAND flash.

config SPI_NAND_ZBIT
	bool "Support Zbit SPI NAND"
	default n
	help
	  Enable this driver for Zbit SPI NAND flash.

config SPI_NAND_ESMT
	bool "Support ESMT SPI NAND"
	default n
	help
	  Enable this driver for ESMT SPI NAND flash.

config SPI_NAND_UMTEK
	bool "Support UMTEK SPI NAND"
	default n
	help
	  Enable this driver for UnitedMemory SPI NAND flash.

config SPI_NAND_QUANXING
	bool "Support QUANXING SPI NAND"
	default n
	help
	  Enable this driver for QUANXING SPI NAND flash.

config SPI_NAND_XINCUN
	bool "Support XINCUN SPI NAND"
	default n
	help
	  Enable this driver for XINCUN SPI NAND flash.

config SPI_NAND_FUDANMICRO
	bool "Support FUDANMICRO SPI NAND"
	default n
	help
	  Enable this driver for FUDANMICRO SPI NAND flash.
endif
```

## kernel/bsp/maix3/drivers/extdrv/usb_serial/Kconfig
```kconfig
menuconfig RT_USING_USB_SERIAL_DEVICE
    bool "Enable USB serial device"
    default n
    select RT_USING_HEAP
    select ENABLE_CHERRY_USB
    help
        the device abstraction framework for USB to serial port conversion

    if RT_USING_USB_SERIAL_DEVICE
        config USB_SERIAL_DEVICE_ENABLE_HOST
        bool "Enable USB host device"
        default y
        select ENABLE_CHERRY_USB_HOST_CLASS_DRV
        select CHERRY_USB_HOST_ENABLE_CLASS_CDC_ACM

    endif
    
```

## kernel/bsp/maix3/drivers/extdrv/ws2812/Kconfig
```kconfig
menuconfig RT_USING_WS2812
    bool "Enable WS2812"
    default n

    if RT_USING_WS2812
        choice WS2812_USE_DRV
            bool "WS2812 Use Drive mode"
            default WS2812_USE_DRV_GPIO

            config WS2812_USE_DRV_GPIO
                bool "Using GPIO"
            config WS2812_USE_DRV_I2S
                bool "Using I2S"
        endchoice
    endif
```
