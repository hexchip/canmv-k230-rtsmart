## kernel/bsp/maix3/drivers/interdrv/Kconfig
```kconfig
menu "InterDriver"
    config RT_USING_ADC
        bool "Using ADC device drivers"
        default n

    menuconfig RT_USING_CIPHER
        bool "Enable CIPHER"
        default n

        if RT_USING_CIPHER
            config RT_USING_AES
                bool "Use HW AES accelerator"
                default n
            config RT_USING_HASH
                bool "Use HW SHA256 accelerator"
                default n
            menuconfig RT_USING_PUFS
                bool "Use HW PUFS accelerator"
                default n

                if RT_USING_PUFS
                    config RT_USING_PUFS_FILE_HASH
                        bool "Enable calculate file hash with pufs"
                        default n
                endif
        endif

    config RT_USING_GNNE
        bool "Enable GNNE driver for ai"
        default y

    menuconfig RT_USING_GPIO
        bool "Enable GPIO Driver"
        default n

        if RT_USING_GPIO
            choice
                bool "GPIO IRQ Method"

                config RT_GPIO_IRQ_METHOD_WORKQUEUE
                    bool "WorkQueue"
                config RT_GPIO_IRQ_METHOD_DIRECT
                    bool "Direct"
            endchoice
        endif

    menuconfig RT_USING_HARDLOCK
        bool "Enable HardLock Driver"
        default n

        if RT_USING_HARDLOCK
            config RT_HARD_LOCK_USE_DUMMY
                bool "Use Dummy HardLock Impl"
                default y
        endif

    menuconfig RT_USING_HWTIMER
        bool "Using hardware timer device drivers"
        default n

        if RT_USING_HWTIMER
            choice
                bool "Timer IRQ Method"

                config RT_TIMER_IRQ_METHOD_WORKQUEUE
                    bool "WorkQueue"
                config RT_TIMER_IRQ_METHOD_DIRECT
                    bool "Direct"
            endchoice

            config RT_USING_HW_TIMER0
                bool "Enable HW Timer0"
                default n
            config RT_USING_HW_TIMER1
                bool "Enable HW Timer1"
                default n
            config RT_USING_HW_TIMER2
                bool "Enable HW Timer2"
                default n
            config RT_USING_HW_TIMER3
                bool "Enable HW Timer3"
                default n
            config RT_USING_HW_TIMER4
                bool "Enable HW Timer4"
                default n
            config RT_USING_HW_TIMER5
                bool "Enable HW Timer5"
                default n
        endif

    menuconfig RT_USING_I2C
        bool "Enable I2C"
        default n

        if RT_USING_I2C
            config RT_USING_SOFT_I2C
                bool "Enable Soft I2C"
                default n

            config RT_USING_I2C_SLAVE_EEPROM
                bool "Enable I2C Slave Server as eeprom"
                default n

            config RT_USING_I2C0
                bool "Enable I2C0"
                default n

                if RT_USING_I2C0
                    config RT_USING_I2C0_SLAVE
                    bool "Enable I2C0 SLAVE mode"
                    select RT_USING_I2C_SLAVE_EEPROM
                    default n
                endif
            config RT_USING_I2C1
                bool "Enable I2C1"
                default n

                if RT_USING_I2C1
                    config RT_USING_I2C1_SLAVE
                    bool "Enable I2C1 SLAVE mode"
                    select RT_USING_I2C_SLAVE_EEPROM
                    default n
                endif
            config RT_USING_I2C2
                bool "Enable I2C2"
                default n

                if RT_USING_I2C2
                    config RT_USING_I2C2_SLAVE
                    bool "Enable I2C2 SLAVE mode"
                    select RT_USING_I2C_SLAVE_EEPROM
                    default n
                endif
            config RT_USING_I2C3
                bool "Enable I2C3"
                default n

                if RT_USING_I2C3
                    config RT_USING_I2C3_SLAVE
                    bool "Enable I2C3 SLAVE mode"
                    select RT_USING_I2C_SLAVE_EEPROM
                    default n
                endif
            config RT_USING_I2C4
                bool "Enable I2C4"
                default n

                if RT_USING_I2C4
                    config RT_USING_I2C4_SLAVE
                    bool "Enable I2C4 SLAVE mode"
                    select RT_USING_I2C_SLAVE_EEPROM
                    default n
                endif
        endif

    config RT_USING_PDMA
        bool "Enable PDMA Driver"
        default n

    config RT_USING_PWM
        bool "Using PWM device drivers"
        default n

    config RT_USING_RTC_PMU
        bool "Using RTC device drivers"
        default n
        select RT_USING_RTC

    menuconfig RT_USING_SDIO
        bool "Enable SDIO Driver"
        default n

        if RT_USING_SDIO
            config RT_USING_SDIO0
                bool "Enable SDIO0"
                default n

            if RT_USING_SDIO0
                config RT_SDIO0_EMMC
                    bool "SDIO0 device is eMMC Card"
                    default n
                config RT_SDIO0_1V8
                    bool "SDIO0 device is 1.8V"
                    default n
            endif

            config RT_USING_SDIO1
                bool "Enable SDIO1"
                default n
        endif

    menuconfig RT_USING_SPI
        bool "Enable SPI Driver"
        default n

        if RT_USING_SPI
            config RT_USING_SPI0
                bool "Enable SPI0"
                default n
            config RT_SPI0_RXSD
                int "SPI0 ReadSample Delay"
                default 0

            config RT_USING_SPI1
                bool "Enable SPI1"
                default n
            config RT_SPI1_RXSD
                int "SPI1 ReadSample Delay"
                default 0

            config RT_USING_SPI2
                bool "Enable SPI2"
                default n
            config RT_SPI2_RXSD
                int "SPI2 ReadSample Delay"
                default 0
        endif

    menuconfig DRV_SYSCTL_BOOT_FORCE_MODE
        bool "Force Sysctl Boot Mode"
        default n

        if DRV_SYSCTL_BOOT_FORCE_MODE
            choice
                bool "Forct Sysctl Boot From "
                default DRV_SYSCTL_BOOT_FORCE_MODE_MODE_SDCARD

                config DRV_SYSCTL_BOOT_FORCE_MODE_MODE_SPI_NOR
                    bool "Spi Nor Flash"
                config DRV_SYSCTL_BOOT_FORCE_MODE_MODE_SPI_NAND
                    bool "Spi Nand Flash"
                config DRV_SYSCTL_BOOT_FORCE_MODE_MODE_EMMC
                    bool "Emmc (SDIO0)"
                config DRV_SYSCTL_BOOT_FORCE_MODE_MODE_SDCARD
                    bool "SdCard (SDIO1)"
            endchoice

            config DRV_SYSCTL_BOOT_FORCE_MODE_MODE
                int
                default 0 if DRV_SYSCTL_BOOT_FORCE_MODE_MODE_SPI_NOR
                default 1 if DRV_SYSCTL_BOOT_FORCE_MODE_MODE_SPI_NAND
                default 2 if DRV_SYSCTL_BOOT_FORCE_MODE_MODE_EMMC
                default 3 if DRV_SYSCTL_BOOT_FORCE_MODE_MODE_SDCARD
        endif

    menuconfig RT_USING_TS
        bool "Enable Tsensor driver"
        default n

        if RT_USING_TS
            config DRV_TS_USE_RT_DEVICE
                bool "Tsensor driver use RT Device framework"
                default n
        endif

    menuconfig RT_USING_SERIAL
        bool "USING Serial device drivers"
        default n

        if RT_USING_SERIAL
            config RT_SERIAL_ENABLE_UART0
                bool "Enable Uart device 0"
                default y
            config RT_SERIAL_ENABLE_UART1
                bool "Enable Uart device 1"
                default y
            config RT_SERIAL_ENABLE_UART2
                bool "Enable Uart device 2"
                default y
            config RT_SERIAL_ENABLE_UART3
                bool "Enable Uart device 3"
                default y
            config RT_SERIAL_ENABLE_UART4
                bool "Enable Uart device 4"
                default y

            config RT_SERIAL_RECV_BUF_SIZE
                hex "Uart Device Recv Buffer Size"
                default 0x4000
        endif

    config RT_USING_WDT
        bool "Using Watch Dog device drivers"
        default n

endmenu
```
